## config/west.yml
```yaml
manifest:
  remotes:
    - name: mmawdsley
      url-base: https://github.com/mmawdsley
  projects:
    - name: zmk
      remote: mmawdsley
      revision: mouse-pim447
      import: app/west.yml
  self:
    path: config
```
